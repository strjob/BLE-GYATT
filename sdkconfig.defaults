## sdkconfig.defaults
```kconfig
# BLE
CONFIG_BT_ENABLED=y
CONFIG_BT_NIMBLE_ENABLED=y
CONFIG_BT_NIMBLE_50_FEATURE_SUPPORT=n

# MTU 247 — максимум для BLE 5, вмещает полное Subas сообщение
CONFIG_BT_NIMBLE_ATT_PREFERRED_MTU=247

# Power Management
CONFIG_PM_ENABLE=y
CONFIG_FREERTOS_USE_TICKLESS_IDLE=y
CONFIG_FREERTOS_HZ=1000
CONFIG_FREERTOS_IDLE_TIME_BEFORE_SLEEP=3

# LED
CONFIG_BLINK_LED_GPIO=y
CONFIG_BLINK_GPIO=8
```

## sdkconfig.defaults.esp32c6
```kconfig
CONFIG_BLINK_LED_STRIP=y

# BLE Sleep
CONFIG_BT_LE_SLEEP_ENABLE=y
CONFIG_BT_LE_LP_CLK_SRC_MAIN_XTAL=y

# Power Management
CONFIG_PM_DFS_INIT_AUTO=y
CONFIG_PM_POWER_DOWN_CPU_IN_LIGHT_SLEEP=y
CONFIG_ESP_PHY_MAC_BB_PD=y
CONFIG_ESP_SLEEP_POWER_DOWN_FLASH=y
```
