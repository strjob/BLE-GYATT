## main/Kconfig.projbuild
```kconfig
menu "Example Configuration"

    orsource "$IDF_PATH/examples/common_components/env_caps/$IDF_TARGET/Kconfig.env_caps"

    choice BLINK_LED
        prompt "Blink LED type"
        default BLINK_LED_GPIO
        help
            Select the LED type. A normal level controlled LED or an addressable LED strip.
            The default selection is based on the Espressif DevKit boards.
            You can change the default selection according to your board.

        config BLINK_LED_GPIO
            bool "GPIO"
        config BLINK_LED_STRIP
            bool "LED strip"
    endchoice

    choice BLINK_LED_STRIP_BACKEND
        depends on BLINK_LED_STRIP
        prompt "LED strip backend peripheral"
        default BLINK_LED_STRIP_BACKEND_RMT if SOC_RMT_SUPPORTED
        default BLINK_LED_STRIP_BACKEND_SPI
        help
            Select the backend peripheral to drive the LED strip.

        config BLINK_LED_STRIP_BACKEND_RMT
            depends on SOC_RMT_SUPPORTED
            bool "RMT"
        config BLINK_LED_STRIP_BACKEND_SPI
            bool "SPI"
    endchoice

    config BLINK_GPIO
        int "Blink GPIO number"
        range ENV_GPIO_RANGE_MIN ENV_GPIO_OUT_RANGE_MAX
        default 8
        help
            GPIO number (IOxx) to blink on and off the LED.
            Some GPIOs are used for other purposes (flash connections, etc.) and cannot be used to blink.

endmenu

menu "Power Management"
    config SOVA_PM_ENABLE
        bool "Enable automatic light sleep"
        default y
        depends on PM_ENABLE && FREERTOS_USE_TICKLESS_IDLE
        help
            Enable automatic light sleep between BLE events.

    config SOVA_PM_MAX_CPU_FREQ_MHZ
        int "Maximum CPU frequency (MHz)"
        default 160
        depends on SOVA_PM_ENABLE

    config SOVA_PM_MIN_CPU_FREQ_MHZ
        int "Minimum CPU frequency (MHz)"
        default 10
        depends on SOVA_PM_ENABLE
endmenu

menu "Sensor Configuration"

    choice SENSOR_TYPE
        prompt "Sensor type"
        default SENSOR_TYPE_MOCK
        help
            Select the sensor type. Mock generates simulated temperature and humidity data.

        config SENSOR_TYPE_MOCK
            bool "Mock (simulated T+H)"
        config SENSOR_TYPE_DHT22
            bool "DHT22 / AM2302 (RMT backend)"
    endchoice

    config SENSOR_DHT22_GPIO
        int "DHT22 data GPIO number"
        default 10
        depends on SENSOR_TYPE_DHT22
        help
            GPIO pin connected to the DHT22 data line.
            Requires external pull-up resistor (4.7k to 3.3V).

    choice SENSOR_OUTPUT
        prompt "Sensor output"
        default SENSOR_OUTPUT_BOTH
        help
            Select which measurements to include in AD packets.

        config SENSOR_OUTPUT_BOTH
            bool "Temperature + Humidity"
        config SENSOR_OUTPUT_TEMP_ONLY
            bool "Temperature only"
        config SENSOR_OUTPUT_HUM_ONLY
            bool "Humidity only"
    endchoice

    config SUBAS_DEVICE_NAME
        string
        default "MOCK_T"  if SENSOR_TYPE_MOCK  && SENSOR_OUTPUT_TEMP_ONLY
        default "MOCK_H"  if SENSOR_TYPE_MOCK  && SENSOR_OUTPUT_HUM_ONLY
        default "DHT22_T" if SENSOR_TYPE_DHT22 && SENSOR_OUTPUT_TEMP_ONLY
        default "DHT22_H" if SENSOR_TYPE_DHT22 && SENSOR_OUTPUT_HUM_ONLY
        default "MOCK_TH" if SENSOR_TYPE_MOCK
        default "DHT22"   if SENSOR_TYPE_DHT22

    config SENSOR_DEFAULT_INTERVAL_MS
        int "Default polling interval (ms)"
        default 1000
        range 100 60000
        help
            Default interval for periodic sensor data notifications (in milliseconds).
            Minimum 100ms, maximum 60000ms.

endmenu
```
